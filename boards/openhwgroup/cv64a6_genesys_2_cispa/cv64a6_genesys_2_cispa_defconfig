## boards/openhwgroup/cv64a6_genesys_2_cispa/cv64a6_genesys_2_cispa_defconfig
```kconfig
# Copyright 2024 CISPA Helmholtz Center for Information Security gGmbH
# SPDX-License-Identifier: Apache-2.0
CONFIG_INCLUDE_RESET_VECTOR=y
CONFIG_CONSOLE=y
CONFIG_SERIAL=y
CONFIG_UART_CONSOLE=y
CONFIG_UART_NS16550=y
CONFIG_UART_NS16550_ACCESS_WORD_ONLY=y
CONFIG_CONSOLE_HANDLER=y
CONFIG_EARLY_CONSOLE=y
CONFIG_XIP=n
CONFIG_INIT_STACKS=y
CONFIG_SYS_CLOCK_TICKS_PER_SEC=25000000

# Ethernet / Networking
CONFIG_DMA=y
CONFIG_DMA_64BIT=y
CONFIG_DMA_XILINX_AXI_DMA=y
CONFIG_ETH_DRIVER=y
CONFIG_NET_L2_ETHERNET=y
CONFIG_ETH_XILINX_AXIENET=y
CONFIG_MDIO=y
CONFIG_PHY_GENERIC_MII=y
CONFIG_MDIO_XILINX_AXI_ENET=y
CONFIG_NET_L2_ETHERNET_MGMT=y
CONFIG_NET_PKT_RX_COUNT=512
CONFIG_NET_TC_RX_COUNT=1
CONFIG_NET_TC_TX_COUNT=1

CONFIG_DMA_XILINX_AXI_DMA_LOCK_DMA_IRQS=y
CONFIG_DMA_XILINX_AXI_DMA_INTERRUPT_THRESHOLD=1
CONFIG_SOC_FAMILY_CVA6_PROVIDE_NONSTANDARD_CACHE_OPTIONS=y
CONFIG_DMA_XILINX_AXI_DMA_DISABLE_CACHE_WHEN_ACCESSING_SG_DESCRIPTORS=y

CONFIG_LOG_MODE_MINIMAL=y
# CONFIG_DMA_LOG_LEVEL_DBG=y

# RNG
CONFIG_TIMER_RANDOM_GENERATOR=y
CONFIG_TEST_RANDOM_GENERATOR=y
```

## soc/openhwgroup/cva6/Kconfig.soc
```kconfig
#Copyright 2024 CISPA Helmholtz Center for Information Security gGmbH
#SPDX-License-Identifier: Apache-2.0

config SOC_FAMILY_OPENHWGROUP_CVA6
	bool
	select RISCV
	help
	  CVA6 RISC-V CPUs, commonly used as soft cores on FPGAs.
	  There is a 64-bit version with imafdc extensions and sv39 MMU and
	  several 32-bit configurations, optionally with up to imafdc and sv32 MMU.

config SOC_FAMILY
	default "ariane_cva6" if SOC_FAMILY_OPENHWGROUP_CVA6


config SOC_FAMILY_CVA6_PROVIDE_NONSTANDARD_CACHE_OPTIONS
	bool "Include non-standard cache management operations (currently global cache disable)"
	depends on SOC_FAMILY_OPENHWGROUP_CVA6
	default n

config SOC_FAMILY_CVA6_PROVIDE_TEST_POWEROFF
	bool "Include methods for terminating a test in the CV32a6 test harness (hardware simulation)"
	depends on SOC_FAMILY_OPENHWGROUP_CVA6
	default n

config SOC_FAMILY_CVA6_PROVIDE_FPGA_POWEROFF
	bool "Include methods for terminating a test on the FPGA"
	depends on SOC_FAMILY_OPENHWGROUP_CVA6
	default n

rsource "*/Kconfig.soc"
```

## soc/openhwgroup/cva6/cv64a6/Kconfig
```kconfig
# Copyright 2024 CISPA Helmholtz Center for Information Security gGmbH
# SPDX-License-Identifier: Apache-2.0
# RISCV64 OpenHW Group cva6 configuration options

config SOC_CV64A6_IMAFDC
	select RISCV_PRIVILEGED
	select ATOMIC_OPERATIONS_BUILTIN
	select RISCV_GP
	select RISCV_HAS_PLIC
	select USE_SWITCH_SUPPORTED
	select USE_SWITCH
	select CPU_HAS_FPU
	select CPU_HAS_FPU_DOUBLE_PRECISION
	select SCHED_IPI_SUPPORTED
	select 64BIT
	select RISCV_ISA_RV64I
	select RISCV_ISA_EXT_M
	select RISCV_ISA_EXT_A
	select RISCV_ISA_EXT_C
	select RISCV_ISA_EXT_F
	select RISCV_ISA_EXT_D
	select RISCV_ISA_EXT_ZICSR
	select RISCV_ISA_EXT_ZIFENCEI
	select HAS_POWEROFF
	select CPU_HAS_DCACHE
	select CPU_HAS_ICACHE

config SOC_CV64A6_IMAC
	select RISCV_PRIVILEGED
	select ATOMIC_OPERATIONS_BUILTIN
	select RISCV_GP
	select RISCV_HAS_PLIC
	select USE_SWITCH_SUPPORTED
	select USE_SWITCH
	select SCHED_IPI_SUPPORTED
	select 64BIT
	select RISCV_ISA_RV64I
	select RISCV_ISA_EXT_M
	select RISCV_ISA_EXT_A
	select RISCV_ISA_EXT_C
	select RISCV_ISA_EXT_ZICSR
	select RISCV_ISA_EXT_ZIFENCEI
	select HAS_POWEROFF
	select CPU_HAS_DCACHE
	select CPU_HAS_ICACHE
```
