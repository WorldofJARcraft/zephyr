// SPDX-License-Identifier: Apache-2.0
// Copyright 2024 CISPA Helmholtz Center for Information Security

#include "cva6.dtsi"

// minimal configuration of CVA6 32-bit CPUs: no instruction set extensions,
// no MMU, no PMP
/ {
	cpus_0: cpus {
		timebase-frequency = <25000000>;

		cpu_0: cpu {
			clock-frequency = <50000000>;
			device_type = "cpu";
			status = "okay";
			compatible = "riscv";
			riscv,isa = "rv32ima";

			status="okay";

			hlic: interrupt-controller {
				#interrupt-cells = <0x01>;
				interrupt-controller;
				compatible = "riscv,cpu-intc";
				status="okay";
			};
		};
	};

};
